## boards/shields/dm_4x6_3/Kconfig.defconfig
```kconfig
if SHIELD_DM_4x6_3_LEFT

config ZMK_KEYBOARD_NAME
    default "Dactyl Manuform"

config ZMK_SPLIT_ROLE_CENTRAL
    default y

endif

if SHIELD_DM_4x6_3_LEFT || SHIELD_DM_4x6_3_RIGHT

config ZMK_SPLIT
    default y

endif
```

## boards/shields/dm_4x6_3/Kconfig.shield
```kconfig
config SHIELD_DM_4x6_3_LEFT
    def_bool $(shields_list_contains,dm_4x6_3_left)

config SHIELD_DM_4x6_3_RIGHT
    def_bool $(shields_list_contains,dm_4x6_3_right)
```

## config/boards/shields/dm_4x6_3/Kconfig.shield
```kconfig
# config SHIELD_DM_4x6_3
#     def_bool $(shields_list_contains, dm_4x6_3)

config SHIELD_DM_4x6_3_LEFT
    def_bool $(shields_list_contains, dm_4x6_3_left)
#     select SHIELD_DM_4x6_3

config SHIELD_DM_4x6_3_RIGHT
    def_bool $(shields_list_contains, dm_4x6_3_right)
#     select SHIELD_DM_4x6_3
```
