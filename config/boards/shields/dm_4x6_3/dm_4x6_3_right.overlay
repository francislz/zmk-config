#include "dm_4x6_3.dtsi"

&default_transform {
    col-offset = <6>;
};

&kscan0 {
    col-gpios
			= <&nrf_gpio 10  GPIO_ACTIVE_HIGH>
			, <&nrf_gpio 16  GPIO_ACTIVE_HIGH>
			, <&nrf_gpio 14  GPIO_ACTIVE_HIGH>
			, <&nrf_gpio 15  GPIO_ACTIVE_HIGH>
			, <&nrf_gpio 18  GPIO_ACTIVE_HIGH>
            , <&nrf_gpio 19  GPIO_ACTIVE_HIGH>
			;
};

// &right_encoder {
// 	status = "okay";
// };